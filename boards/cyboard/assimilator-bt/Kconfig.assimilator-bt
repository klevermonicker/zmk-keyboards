## boards/cyboard/assimilator-bt/Kconfig.assimilator-bt
```kconfig
# SPDX-License-Identifier: MIT

config BOARD_ASSIMILATOR_BT
    select SOC_NRF52840_QIAA
    select ZMK_BOARD_COMPAT if BOARD_ASSIMILATOR_BT_NRF52840_ZMK
    imply RETAINED_MEM if BOARD_ASSIMILATOR_BT_NRF52840_ZMK
    imply RETENTION if BOARD_ASSIMILATOR_BT_NRF52840_ZMK
    imply RETENTION_BOOT_MODE if BOARD_ASSIMILATOR_BT_NRF52840_ZMK
```
